## components/status_led/Kconfig
```kconfig
menu "ULANI status LED"

config ULANI_STATUS_LED_ENABLE
    bool "Enable the status LED"
    default y
    help
        Drives an on-board LED as a status light: off when idle, solid while
        talking to a Tesserae server, and blinking while streaming a frame to
        the calendar over BLE. Turn this off to leave the pin alone.

choice ULANI_BOARD
    prompt "Board preset (sets the LED pin)"
    depends on ULANI_STATUS_LED_ENABLE
    default ULANI_BOARD_C3_SUPERMINI
    help
        ESP-IDF has no built-in board database (unlike Zephyr's devicetree), so
        the LED pin is chosen here. Pick your board for sensible defaults, or
        Custom to set the pin and polarity by hand. Add a new board by adding a
        preset below and giving it defaults on the two options that follow.

config ULANI_BOARD_C3_SUPERMINI
    bool "ESP32-C3 Super Mini (blue LED on GPIO8, active-low)"

config ULANI_BOARD_CUSTOM
    bool "Custom"

endchoice

config ULANI_STATUS_LED_GPIO
    int "Status LED GPIO number"
    depends on ULANI_STATUS_LED_ENABLE
    default 8 if ULANI_BOARD_C3_SUPERMINI
    default 8 if ULANI_BOARD_CUSTOM
    range 0 48
    help
        The GPIO the status LED is wired to.

config ULANI_STATUS_LED_ACTIVE_LOW
    bool "LED is active-low (lit when the pin is driven low)"
    depends on ULANI_STATUS_LED_ENABLE
    default y if ULANI_BOARD_C3_SUPERMINI
    default n if ULANI_BOARD_CUSTOM
    help
        The C3 Super Mini's blue LED lights when GPIO8 is pulled low, so it is
        active-low. Most discrete "wire an LED to a pin" designs are active-high.

endmenu
```

## components/ulani_ble/Kconfig.projbuild
```kconfig
menu "ULANI BLE"

config ULANI_BLE_ALLOW_PAIRING
    bool "Pair when the calendar demands an encrypted link"
    default y
    help
        The calendar rejects CCCD writes on an unencrypted link with ATT error
        0x05 (insufficient authentication), which is why the reference Node.js
        implementation requires an OS-level pairing first. With this enabled the
        firmware reacts to that rejection by pairing and retrying, so a unit
        that does not care is never bothered. Turn it off to see the raw
        rejection instead.

config ULANI_BLE_SECURE_CONNECTIONS
    bool "Offer LE Secure Connections when pairing"
    default n
    help
        The calendar asks for Secure Connections in its Security Request, but
        answering in kind gets the link dropped without so much as a Pairing
        Response. LE Legacy pairing is spec-legal to offer regardless of what
        the peer advertises and is what 2019-era hardware was actually tested
        against, so it is the default here. Flip this back on if legacy also
        fails, to see which one the device complains about.

config ULANI_BLE_CHUNK_GAP_MS
    int "Delay between image data packets (ms)"
    default 20
    range 0 200
    help
        The reference implementation waits 20 ms between the 230-byte writes
        that make up an image. Raising this makes a transfer slower but can help
        if the panel drops packets while WiFi is busy.

endmenu
```
